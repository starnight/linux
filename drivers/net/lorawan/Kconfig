## drivers/net/lorawan/Kconfig
```kconfig
menuconfig LORAWAN_DRIVERS
	tristate "LoRaWAN drivers"
	depends on LORAWAN
	default y
	---help---
	  Say Y here to get to see options for LoRaWAN compatible device
	  drivers. This option alone does not add any kernel code.

	  If you say N, all options in this submenu will be skipped and
	  disabled.

config LORAWAN_FAKELR
	depends on LORAWAN_DRIVERS
	tristate "LoRa virtual driver"
	---help---
	  Say Y here to enable the fake driver that can emulate a net
	  of several interconnected radio devices.

	  This driver can also be built as a module. To do so say M here.
	  The module will be called 'fakelr'.
```

## net/lorawan/Kconfig
```kconfig
config LORAWAN
	tristate "LoRaWAN Low Power and Long Range Networks support"
	select CRYPTO
	select CRYPTO_CMAC
	select CRYPTO_CBC
	select CRYPTO_AES
	---help---
	  LoRaWAN defines a low data rate, low power and long range wireless
	  wide area networks. It was designed to organise networks of sensors,
	  switches and actuators, etc automation devices.  It could operate as
	  multiple kilometers wide.

	  Say Y here to compile LoRaWAN support into the kernel or say M to
	  compile it as modules.
```
